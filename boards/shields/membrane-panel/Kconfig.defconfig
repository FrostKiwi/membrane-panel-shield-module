## boards/shields/membrane-panel/Kconfig.defconfig
```kconfig
if MEMBRANE_PANEL

# Name must be less than 16 characters long!
config ZMK_KEYBOARD_NAME
    default "Membrane Panel"

config ZMK_KSCAN_MATRIX_WAIT_BETWEEN_OUTPUTS
    default 10
config ZMK_KSCAN_MATRIX_WAIT_BEFORE_INPUTS
    default 10

endif
```

## boards/shields/membrane-panel/Kconfig.shield
```kconfig
# No whitespace after the comma or in your keyboard name!
config MEMBRANE_PANEL
    def_bool $(shields_list_contains,membrane_panel)
```
